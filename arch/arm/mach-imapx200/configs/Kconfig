## arch/arm/mach-imapx200/configs/Kconfig
```kconfig
#
# Kconfig.
#
# Copyright (c) 2009~2014 ShangHai Infotm Ltd all rights reserved.
#
# GPIO system compile configurations.
#
# Sololz<sololz.luo@gmail.com>.
#

config IG_BRAND_MARK
bool "-"
default n

menu "Board setup"

config IG_BOARD_STRING
	string "board identity string"
	default "baseboard:board"
	help
	  Input your board name string here. For example, if your
	  board is p0106ra which is based on infotm wwe10. You
	  input "wwe10:p0106ra".

# Modules GPIO definitions.
# source "arch/arm/mach-imapx200/gpio/configs/misc_Kconfig"

# power
source "arch/arm/mach-imapx200/configs/power_config"
# LCD
source "arch/arm/mach-imapx200/configs/lcd_config"
# touch screen
source "arch/arm/mach-imapx200/configs/touchscreen_config"
# hdmi
source "arch/arm/mach-imapx200/configs/hdmi_config"
# camera
source "arch/arm/mach-imapx200/configs/camif0_config"
source "arch/arm/mach-imapx200/configs/camif1_config"
# codec
source "arch/arm/mach-imapx200/configs/codec_config"
# battery
source "arch/arm/mach-imapx200/configs/battery_config"
# accelarometers
source "arch/arm/mach-imapx200/configs/acc_config"
# keyboard
source "arch/arm/mach-imapx200/configs/keyboard_config"
# logo
source "arch/arm/mach-imapx200/configs/logo_config"
# i2c
source "arch/arm/mach-imapx200/configs/i2c_config"
# TODO: more devices/gpios tobe added.

endmenu
```

## arch/arm/mach-imapx200/gpio/Kconfig
```kconfig
#
# Kconfig.
#
# Copyright (c) 2009~2014 ShangHai Infotm Ltd all rights reserved.
#
# GPIO system compile configurations.
#
# Sololz<sololz.luo@gmail.com>.
#

menuconfig IMAPX_GPIO_SYSTEM
	bool "IMAPX GPIO process and configuration system support"
	default y
	select IG_DEVICE_GPIO_CONFIG
	---help---
	Make life easier, please choose me.

if IMAPX_GPIO_SYSTEM

config IG_PANIC_ENABLE
	bool "Enable panic mechanism or just print error message"
	default n
	---help---
	If it is enabled, gpio base process system might panic to protect
	kernel from error operations. If not, just print error messages.

config IG_DEBUG_ENABLE
	bool "Enable debug message print of GPIO driver"
	default n
	---help---
	Print debug message of each API operation status and objects.

source "arch/arm/mach-imapx200/gpio/base/Kconfig"

menuconfig IG_DEVICE_GPIO_CONFIG
	bool "Config all GPIO of relate devices"
	default y
	select IG_DEVICE_GPIO_MISC

if IG_DEVICE_GPIO_CONFIG

# Modules GPIO definitions.
# source "arch/arm/mach-imapx200/gpio/configs/misc_Kconfig"

# power
source "arch/arm/mach-imapx200/gpio/configs/power_config"
# LCD
source "arch/arm/mach-imapx200/gpio/configs/lcd_config"
# touch screen
source "arch/arm/mach-imapx200/gpio/configs/touchscreen_config"
# hdmi
source "arch/arm/mach-imapx200/gpio/configs/hdmi_config"
# camera
source "arch/arm/mach-imapx200/gpio/configs/camif0_config"
source "arch/arm/mach-imapx200/gpio/configs/camif1_config"
# codec
source "arch/arm/mach-imapx200/gpio/configs/codec_config"
# battery
source "arch/arm/mach-imapx200/gpio/configs/battery_config"
# accelarometers
source "arch/arm/mach-imapx200/gpio/configs/acc_config"
# TODO: more devices/gpios tobe added.

endif	# IG_DEVICE_GPIO_CONFIG

endif
```

## arch/arm/plat-imap/Kconfig
```kconfig
# arch/arm/plat-imap/Kconfig
#
# Copyright (c) 2009~2014 ShangHai Infotm Ltd all rights reserved.
#
# Licensed under GPLv2

config PLAT_IMAP
	bool
	depends on ARCH_IMAP
	default y if ARCH_IMAP
	select NO_IOPORT
	select ARCH_REQUIRE_GPIOLIB
	help
	  Base platform code for any Infotm IMAP device

if PLAT_IMAP

config PLAT_IMAPX200
	bool "IMAPX200 Platform support"
	depends on ARCH_IMAP
	default y if CPU_IMAPX200
	help
	  Support for Infotm IMAPX200 CPU based systems.

config PANIC_DUMP
	bool "Support for production panic dump"
	depends on PLAT_IMAP
	default n

config FBCON_DRAW_PANIC_TEXT
	bool "Support for production panic text"
	depends on PLAT_IMAP
	default n

config IMAPX200_PWM
	bool "PWM device support"
	default y if CPU_IMAPX200
	select HAVE_PWM
	help
	  Support for exporting the PWM timer blocks via the pwm device
	  system.

config IMAPX200_DMA
	bool "IMAPX200 DMA support"
	depends on ARCH_IMAP
	help
	  IMAPX200 DMA support. This is needed for drivers like sound which
	  use the DMA system to move data to and from the peripheral blocks.

config IMAPX200_DMA_DEBUG
	bool "IMAPX200 DMA support debug"
	depends on ARCH_IMAP && IMAPX200_DMA
	help
	  Enable debugging output for the DMA code. This option sends info
	  to the kernel log, at priority KERN_DEBUG.

config IMAP_LOWLEVEL_UART_PORT
	int "IMAP UART to use for low-level messages"
	depends on PLAT_IMAP
	default 0
	help
	  Choice of which UART port to use for the low-level messages,
	  such as the `Uncompressing...` at start time. The value of
	  this configuration should be between zero and two. The port
	  must have been initialised by the boot-loader before use.

config	FAKE_PM 
	bool "Support for fake power manage"
	depends on PLAT_IMAP 
	default n

config PM_SHUT_DOWN
	bool "iMAPx200 PM shut down"
	depends on PLAT_IMAP 
	default n
	help
	  If you enable this feature, system will be wake up after a pre-
	  configured time in suspend mode and shutdown. The shutdown is
	  unsafe, so only enabled this if you really have a reason.

config PM_SHUT_DOWN_SEC
	int "Shut down seconds count"
	depends on PM_SHUT_DOWN
	default 1800
	help
	  System will wake up and shutdown PM_SHUT_DOWN_SEC after enter
	  suspending mode.

	  Set this value to 13 will perform a PM test, this will not shutdown
	  the machine but only wakeup after 13 seconds.


comment "iMAP Settings"

menu "iMAP Reserved Memory"

config IMAP_RESERVEMEM_SIZE_ETH
	int "Memory Size Reserved for Ethernet (KB)"
	depends on ARCH_IMAP && GMAC_UNIV_ETHERNET
	default "0"
config IMAP_RESERVEMEM_SIZE_PMEM
	int "Memory Size Reserved for Android_pmem (KB)"
	depends on ARCH_IMAP && ANDROID_PMEM
	default "0"

endmenu

menu "iMAP GPIO API config"

config IG_PANIC_ENABLE
	bool "Enable panic mechanism or just print error message"
	default n
	---help---
	If it is enabled, gpio base process system might panic to protect
	kernel from error operations. If not, just print error messages.

config IG_DEBUG_ENABLE
	bool "Enable debug message print of GPIO driver"
	default n
	---help---
	Print debug message of each API operation status and objects.
endmenu

config IMAP_FPGA
	bool "iMAP FPGA Clock"
	depends on ARCH_IMAP
	default n
	help
	  If you are operating on the FPGA platform, say Y here!

config FPGA_EXT_CLOCK
	int "FPGA External Clock Setting"
	depends on IMAP_FPGA
	default "40000000"

endif
```

## drivers/asysops/Kconfig
```kconfig
#
# ops_infotm
#
# sololz
#

menuconfig ASYSOPS
	bool "Shared memory, message, lock for Android"
	default y
	---help---
	In Android, standard Unix shared memory, message and lock is abandoned 
	by Google. Instead, Google implements a so called binder to do similar
	operations. But we consider it to be so much complex and too hard to 
	preserve, so we write the same driver to implement it with easier usage.

config ASYSOPS_DEBUG
	bool "print Memalloc debug messages"
	depends on ASYSOPS
	default n
```

## drivers/bluetooth/imapx200_bluetooth/Kconfig
```kconfig
#
# Kconfig of IMAPX200 bluetooth driver.
#
# Sololz <sololz.luo@gmail.com>.
#

menuconfig IMAPX200_BLUETOOTH_DEVICE_SUPPORT
	bool "IMAPX200 bluetooth devices support"
	default n
	---help---
	TODO

if IMAPX200_BLUETOOTH_DEVICE_SUPPORT
config IMAPX200_BLUETOOTH_DEBUG
	bool "Debug message print for IMAPX200 bluetooth driver."
	default n
	---help---
	TODO

config IMAPX200_BLUETOOTH_DEVICE_RDA5872P
	bool "Support for RDA5872p v2.1 + EDR bluetooth module"
	default y
	---help---
	TODO
endif
```

## drivers/media/camif/Kconfig
```kconfig
# Haixu Fu
#
config IMAP_CAMIF
	bool "Infotm Imapx200 camif driver"
	default n
	depends on (IG_DEVICE_CAMERA0 || IG_DEVICE_CAMERA1)
	---help---
	This is the driver for iMapx200 camera interface,Say Y here If you
	have a imapx200 product
config IMAP_CAMIF_DEBUG
	bool "Infotm Imapx200 debug"
	depends on IMAP_CAMIF 
	default n
	
```

## drivers/soops/Kconfig
```kconfig
#
# Kconfig of soops char device driver.
#
# InfoTM all rights reserved.
#
# Sololz <sololz.luo@gmail.com>.
#

menuconfig SOOPS
	bool "Complicated operations char device driver created by Sololz"
	default n
	---help---
	First I design this driver to implement Capslock key communication with
	application.

if SOOPS

config SOOPS_DEBUG
	bool "Debug message print for soops"
	depends on SOOPS
	default n

endif	# SOOPS
```

## drivers/switch/Kconfig
```kconfig
menuconfig SWITCH
	tristate "Switch class support"
	help
	  Say Y here to enable switch class support. This allows
	  monitoring switches by userspace via sysfs and uevent.

if SWITCH

config SWITCH_GPIO
	tristate "GPIO Swith support"
	depends on GENERIC_GPIO
	help
	  Say Y here to enable GPIO based switch support.

config SWITCH_SENSOR
	tristate "G-sensor switch support"
	depends on GENERIC_GPIO
	help
	  Say Y here to enable g-sensor switch support.

endif # SWITCH
```

## drivers/video/hdmi/si9022/Kconfig
```kconfig
#
## TV/VGA Output configuration
#

config HDMI_OUTPUT_SUPPORT
tristate "HDMI Output Support"
depends on FB
default n
---help---
TBA
```

## drivers/video/infotm/Kconfig
```kconfig
#
# IMAP Video Configuration
#

config FB_IMAP
	tristate "IMAP Framebuffer Support"
	select FB_CFB_FILLRECT
	select FB_CFB_COPYAREA
	select FB_CFB_IMAGEBLIT
	select FRAMEBUFFER_CONSOLE
	select LOGO
	select LOGO_LINUX_LANDSCAPED_CLUT224
	depends on FB && ARCH_IMAP

	default y
	---help---
	TBA

config FB_IMAP_BPP
	tristate "Advanced options for IMAP Framebuffer"
	depends on FB_IMAP
	default y
	---help---
	TBA

choice
depends on FB_IMAP_BPP
prompt "Select BPP(Bits Per Pixel)"
default FB_IMAP_BPP16
config FB_IMAP_BPP8
	bool "8BPP A1RGB232"
	---help---
	TBA

config FB_IMAP_BPP16
	bool "16BPP RGB565"
	---help---
	TBA

config FB_IMAP_BPP18
	bool "18BPP RGB666"
	---help---
	TBA

config FB_IMAP_BPP19
	bool "19BPP A1RGB666"
	---help---
	TBA
	
config FB_IMAP_BPP24
	bool "24BPP RGB888"
	---help---
	TBA
	
config FB_IMAP_BPP25
	bool "25BPP A1RGB888"
	---help---
	TBA
	
config FB_IMAP_BPP28
	bool "28BPP A4RGB888"
	---help---
	TBA
	
config FB_IMAP_BPP32
	bool "32BPP A8RGB888"
	---help---
	TBA	
endchoice

config FB_IMAP_NUM
	int "Number of Framebuffers"
	depends on FB_IMAP_BPP && ARCH_IMAP
	default "1"
	---help---
	TBA

config FB_IMAP_VIRTUAL_SCREEN
	bool "Enable Virtual Screen"
	depends on FB_IMAP_BPP

	default n
	---help---
	TBA

config FB_IMAP_DOUBLE_BUFFER
	bool "Enable Double Buffer"
	depends on FB_IMAP_BPP
	default n
	---help---
	TBA

config LCD_FOR_PRODUCT
        bool "Product LCD Driver Select"
        depends on FB_IMAP_BPP

        default n
        ---help---
        If you are using product board, please select this option.

config LCD_ENABLE_IRQ
	bool "Enable LCD interrupt"
	depends on FB_IMAP

	default n
	---help---
	  Enable framebuffer driver to setup a interrupt instance.
```

## sound/soc/imapx200/Kconfig
```kconfig
menu "SoC Audio for the INFOTM SOC"

config SND_IMAPX_SOC
	tristate "SoC Audio for the Infotm Imapx chips"
	depends on ARCH_IMAP && SND_SOC
	select SND_PCM
	help
	  Say Y or M if you want to add support for codecs attached to
	  the AC97, I2S interface. You will also need
	  to select the audio interfaces to support below.

config AUDIO_CODEC_PROCFS
    bool "Proc-FS interface for audio codec control"
	depends on CODEC_WM8987 && PROC_FS
	default y

config SND_IMAPX200_SOC_AC97
	tristate
	select AC97_BUS
	select SND_AC97_CODEC
	select SND_SOC_AC97_BUS

config SND_IMAPX200_SOC_I2S
	tristate

endmenu
```
